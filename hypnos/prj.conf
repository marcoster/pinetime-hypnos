## prj.conf
```kconfig
# SPDX-License-Identifier: Apache-2.0

# Battery status
CONFIG_ADC=y
CONFIG_ADC_ASYNC=y

# GPIO
CONFIG_GPIO=y

# Time functions
CONFIG_NEWLIB_LIBC=y

# Display
CONFIG_SPI=y
CONFIG_DISPLAY=y
CONFIG_ST7789V=y
CONFIG_ST7789V_RGB565=y

# Graphics
CONFIG_LVGL=y
CONFIG_LVGL_OBJ_LABEL=y
CONFIG_LVGL_OBJ_IMAGE=y
CONFIG_LVGL_COLOR_DEPTH_16=y
CONFIG_LVGL_COLOR_16_SWAP=y
CONFIG_LVGL_BITS_PER_PIXEL=24
CONFIG_LVGL_HOR_RES=240
CONFIG_LVGL_VER_RES=240
CONFIG_LVGL_DISPLAY_DEV_NAME="DISPLAY"
CONFIG_LVGL_BUILD_IN_FONT_ROBOTO_22=y
CONFIG_LVGL_DEFAULT_FONT_BUILD_IN_ROBOTO_22=y
CONFIG_LVGL_TXT_ENC_UTF8=y

# Touch screen
CONFIG_SENSOR=y
CONFIG_CST816S=y
CONFIG_CST816S_NAME="CST816S"
CONFIG_CST816S_TRIGGER_GLOBAL_THREAD=y

# Bluetooth
CONFIG_BT=y
CONFIG_BT_PERIPHERAL=y
CONFIG_BT_GATT_DIS=y
CONFIG_BT_ATT_PREPARE_COUNT=5
CONFIG_BT_DEVICE_NAME="PineTime Hypnos"
CONFIG_BT_DEVICE_APPEARANCE=833
CONFIG_BT_DEVICE_NAME_DYNAMIC=y
CONFIG_BT_DEVICE_NAME_MAX=65
CONFIG_BT_GATT_CLIENT=y

# Apparently necessary for bluetooth
#CONFIG_HEAP_MEM_POOL_SIZE=16384

# Power management
CONFIG_DEVICE_POWER_MANAGEMENT=y

# Logging
CONFIG_LOG=y
CONFIG_LOG_DEFAULT_LEVEL=4
CONFIG_LOG_BACKEND_RTT=y
CONFIG_LOG_BUFFER_SIZE=2048

CONFIG_DEBUG_INFO=n
```

## src/main.c
```c
/*
 * PineTime Hypnos: Smartwatch firmware for the PineTime dev kit
 * Copyright (c) 2020 Endian Technologies AB
 *
 * Modifications of endian-albin's pinetime-hypnos:
 * Copyright (c) 2020 max00
 *
 * This is free software with ABSOLUTELY NO WARRANTY.
 *
 * SPDX-License-Identifier: MPL-2.0
 */

#include <zephyr.h>
#include <settings/settings.h>
#include "backlight.h"
#include "battery.h"
#include "bt.h"
#include "clock.h"
#include "cts_sync.h"
#include "display.h"
#include "event_handler.h"
#include "gfx.h"
#include "log.h"

void main(void)
{
	LOG_INF("Welcome to PineTime Hypnos!");
    LOG_INF("This is free software with ABSOLUTELY NO WARRANTY.");

    if(IS_ENABLED(CONFIG_SETTINGS)) {
        settings_load();
    }

    ble_init();
    cts_sync_init();
	gfx_init();
	clock_init();
	battery_init();
	display_init();
	event_handler_init();
	gfx_update();
	backlight_init();
}
```

## include/bt.h
```c
#ifndef BT__H
#define BT__H

#include <stdbool.h>

void ble_init(void);
bool ble_is_connected(void);

#endif /* BT__H */
```

## include/cts_sync.h
```c
/*
 * Modifications: Copyright (c) 2020 Endian Technologies AB
 * Copyright (c) 2016 Intel Corporation
 *
 * SPDX-License-Identifier: Apache-2.0
 */

#ifndef CTS__H
#define CTS__H

#include <time.h>
#include <bluetooth/conn.h>

void cts_sync_init(void);
void cts_sync_enable(bool enable);
void cts_get_datetime(struct tm *);

typedef struct {
	uint16_t year;
	uint8_t month;
	uint8_t day;
	uint8_t hours;
	uint8_t minutes;
	uint8_t seconds;
	uint8_t day_of_week;
	uint8_t exact_time_256;
	uint8_t adjust_reason;
} cts_datetime_t;

#endif /* CTS__H */
```

## include/event_handler.h
```c
/*
 * Copyright (c) 2020 Endian Technologies AB
 *
 * SPDX-License-Identifier: MPL-2.0
 */

#ifndef EVENT_HANDLER__H
#define EVENT_HANDLER__H

#include <drivers/gpio.h>
#include <drivers/sensor.h>

void event_handler_init(void);
void display_off_isr(struct k_timer *);
void bt_off_isr(struct k_timer *);
void battery_percentage_isr(struct k_timer *);
void battery_charging_isr(struct device*, struct gpio_callback *, uint32_t);
void button_pressed_isr(struct device *, struct gpio_callback *, uint32_t);
void touch_tap_isr(struct device *, struct sensor_trigger *);

#endif /* EVENT_HANDLER */
```

## src/backlight.c
```c
/*
 * SPDX-License-Identifier: Apache-2.0
 */

#include <zephyr.h>
#include <stdbool.h>
#include <drivers/gpio.h>
#include <display.h>
#include "backlight.h"
#include "log.h"

/* ********** ********** DEFINES ********** ********** ********** */
//#define BACKLIGHT_PORT  DT_ALIAS_LED1_GPIOS_CONTROLLER
//#define BACKLIGHT       DT_ALIAS_LED1_GPIOS_PIN
#define BACKLIGHT_PIN   22
/* ********** **********  ********** ********** ********** */

/* ********** ********** VARIABLES AND STRUCTS ********** ********** */
static struct device* backlight_dev;
static bool backlight_enabled = false;
/* ********** ********** ********** ********** ********** ********** */

/* ********** ********** FUNCTIONS ********** ********** */
void backlight_init()
{
	backlight_dev = device_get_binding("GPIO_0");
	gpio_pin_configure(backlight_dev, BACKLIGHT_PIN, GPIO_OUTPUT);
	backlight_enable(true);
	LOG_DBG("Backlight init: Done");
}

void backlight_enable(bool enable) {
	gpio_pin_set_raw(backlight_dev, BACKLIGHT_PIN, enable ? 0 : 1);
	backlight_enabled = enable;
}

bool backlight_is_enabled()
{
	return backlight_enabled;
}
/* ********** ********** ********** ********** ********** */
```

## src/battery.c
```c
/*
 * Copyright (c) 2020 Endian Technologies AB
 *
 * SPDX-License-Identifier: MPL-2.0
 *
 * battery_mv_to_ppt, battery_level_point, battery_raw_to_mv:
 * Copyright (c) 2020 Nordic Semiconductor
 */

#include <zephyr.h>
#include <zephyr/types.h>
#include <stdint.h>
#include <drivers/gpio.h>
#include <drivers/adc.h>
#include <syscalls/adc.h>
#include <stdbool.h>
#include "battery.h"
#include "gfx.h"
#include "log.h"

#define CHANNEL_ID 7
#define RESOLUTION 12
#define DIVIDER 2
#define COUNT_DOWN 5000

/* ********** ********** VARIABLES ********** ********** */
static struct device* percentage_dev;
static int16_t data[1];
static uint32_t percentage;
static bool charging;
/* ********** ********** ********** ********** ********** */

/* ********** ********** STRUCTS ********** **********  */
struct battery_level_point {
	/** Remaining life at #lvl_mV. */
	uint16_t lvl_pptt;

	/** Battery voltage at #lvl_pptt remaining life. */
	uint16_t lvl_mV;
};

static const struct battery_level_point lipo[] = {
	{ 10000, 4200 },
	{ 5000, 3660},
	{ 2100, 3600 },
	{ 1000, 3560},
	{ 0, 3100 },
};

static const struct adc_sequence sequence = {
	.channels    = BIT(CHANNEL_ID),
	.buffer      = data,
	.buffer_size = sizeof(data),
	.resolution  = RESOLUTION,
};

static const struct adc_channel_cfg m_1st_channel_cfg = {
	.gain             = ADC_GAIN_1_4,
	.reference        = ADC_REF_INTERNAL,
	.acquisition_time = ADC_ACQ_TIME(ADC_ACQ_TIME_MICROSECONDS, 20),
	.channel_id       = CHANNEL_ID,
#if defined(CONFIG_ADC_CONFIGURABLE_INPUTS)
	.input_positive   = 8,
#endif
};

/* ********** ********** ********** ********** ********** */

/* ********** ********** FUNCTIONS ********** ********** */
void battery_init()
{
        percentage_dev = device_get_binding("ADC_0");
        if (percentage_dev == NULL) {
                LOG_ERR("Failed to get binding for ADC_0 device!");
        }

        if (adc_channel_setup(percentage_dev, &m_1st_channel_cfg) < 0) {
                LOG_ERR("Failed to setup channel for adc!");
        }

        LOG_DBG("Battery status init: Done");
}

void battery_update_percentage()
{
	adc_read(percentage_dev, &sequence);
	uint32_t mv = battery_raw_to_mv(data[0]);
	percentage = battery_mv_to_ppt(mv)/100;
}

void battery_update_charging_status(bool value)
{
	charging = value;
}

bool battery_get_charging_status()
{
        return charging;
}

uint32_t battery_raw_to_mv(int16_t raw)
{
	return (DIVIDER*600*(((uint32_t)raw*4*1000) >> RESOLUTION))/1000;
}

uint32_t battery_mv_to_ppt(uint32_t mv)
{
	const struct battery_level_point *pb = lipo;

	if (mv >= pb->lvl_mV) {
		return pb->lvl_pptt;
	}

	while ((pb->lvl_pptt > 0)
	       && (mv < pb->lvl_mV)) {
		++pb;
	}
	if (mv < pb->lvl_mV) {

		return pb->lvl_pptt;
	}

	const struct battery_level_point *pa = pb - 1;

	return pb->lvl_pptt
	       + ((pa->lvl_pptt - pb->lvl_pptt)
		  * (mv - pb->lvl_mV)
		  / (pa->lvl_mV - pb->lvl_mV));
}

void battery_show_status()
{
	battery_update_percentage();
	if (charging) {
		LOG_INF("Battery status: %u%% (charging)",
			percentage);
		gfx_battery_set_label(5);
	} else {
		LOG_INF("Battery status: %u%% (discharging)",
			percentage);

		if (percentage > 89) {
			gfx_battery_set_label(4);
		} else if (percentage > 74) {
			gfx_battery_set_label(3);
		} else if (percentage > 49) {
			gfx_battery_set_label(2);
		} else if (percentage > 24) {
			gfx_battery_set_label(1);
		} else {
			gfx_battery_set_label(0);
		}
	}
}

/* ********** ********** ********** ********** ********** */
```

## src/bt.c
```c
/*
 * Copyright (c) 2015-2016 Intel Corporation
 * Copyright (c) 2020 Endian Technologies AB
 * Copyright (c) 2020 max00
 * SPDX-License-Identifier: Apache-2.0
 */

#include <stddef.h>
#include <stdbool.h>
#include <string.h>
#include <sys/byteorder.h>
#include <zephyr.h>
#include <zephyr/types.h>

#include <bluetooth/bluetooth.h>
#include <bluetooth/hci.h>
#include <bluetooth/conn.h>
#include <bluetooth/uuid.h>
#include <bluetooth/gatt.h>

#include "cts_sync.h"
#include "log.h"
#include "gfx.h"

//---- DEFINITIONS ----//
#define BT_TIMEOUT K_SECONDS(20)


//---- PROTOTYPES ----//
static void ready(int err);
static void connected(struct bt_conn *conn, uint8_t err);
static void disconnected(struct bt_conn *conn, uint8_t reason);
static bool le_param_req(struct bt_conn *conn, struct bt_le_conn_param *param);
static void le_param_updated(struct bt_conn *conn, uint16_t interval, uint16_t latency, uint16_t timeout);


//---- VARIABLES ----//
static const struct bt_data ad[] = {
        BT_DATA_BYTES(BT_DATA_FLAGS, (BT_LE_AD_GENERAL | BT_LE_AD_NO_BREDR)),
        BT_DATA_BYTES(BT_DATA_UUID16_ALL,
              0x22, 0x18, 0x0d, 0x18, 0x05, 0x18),
//        BT_DATA_BYTES(BT_DATA_UUID128_ALL,
//              0xf0, 0xde, 0xbc, 0x9a, 0x78, 0x56, 0x34, 0x12,
//              0x78, 0x56, 0x34, 0x12, 0x78, 0x56, 0x34, 0x12),
};
static struct bt_conn_cb m_conn_callbacks = {
    .connected = connected,
    .disconnected = disconnected,
    .le_param_req = le_param_req,
    .le_param_updated = le_param_updated
};


//---- FUNCTIONS ----//
void ble_init(void)
{
    int err = bt_enable(ready);
    if(err) {
        LOG_ERR("BLE init failed (err %d)", err);
    }
}

bool ble_is_connected(void)
{
    return false;
}


static void ready(int err)
{
    if(err) {
        LOG_ERR("BLE init failed (err %d)", err);
        return;
    }

    bt_conn_cb_register(&m_conn_callbacks);

    struct bt_le_adv_param param = BT_LE_ADV_PARAM_INIT(
        BT_LE_ADV_OPT_CONNECTABLE | BT_LE_ADV_OPT_USE_NAME,
        BT_GAP_ADV_SLOW_INT_MIN,
        BT_GAP_ADV_SLOW_INT_MAX,
        NULL
            );
    err = bt_le_adv_start(&param, ad, ARRAY_SIZE(ad), NULL, 0);
    if(err) {
        LOG_ERR("BLE adv start failed (err %d)", err);
    }
}

static void connected(struct bt_conn *conn, uint8_t err)
{
    LOG_INF("connected %u", err);
    if(err) {
        return;
    }
    cts_sync_enable(true);
    gfx_bt_set_label(1);
}

static void disconnected(struct bt_conn *conn, uint8_t reason)
{
    LOG_INF("disconnected");
    cts_sync_enable(false);
    gfx_bt_set_label(0);
}

static bool le_param_req(struct bt_conn *conn, struct bt_le_conn_param *param)
{
    return true;
}

static void le_param_updated(struct bt_conn *conn, uint16_t interval, uint16_t latency, uint16_t timeout)
{

}
```

## src/clock.c
```c
/*
 * Copyright (c) 2020 Endian Technologies AB
 * Copyright (c) 2020 max00
 *
 * SPDX-License-Identifier: MPL-2.0
 */

#include <zephyr.h>
#include <zephyr/types.h>
#include <time.h>
#include <stdio.h>
#include <stdlib.h>
#include "clock.h"
#include "battery.h"
#include "log.h"
#include "cts_sync.h"
#include "bt.h"
#include "gfx.h"
#include "event_handler.h"

//---- VARIABLES ----//
static time_t local_time;
static struct tm ti = {
    .tm_sec = 0,
    .tm_min = 0,
    .tm_hour = 0,
    .tm_mday = 0,
    .tm_mon = 0,
    .tm_year = 0,
    .tm_wday = 0,
    .tm_isdst = 0,
};


//---- FUNCTIONS ----//
void clock_str_to_local_time(const char *str, struct tm *t)
{
    /* Date and time format: 2020-04-04T20:48:11+02:00 */
    if(sscanf(str, "%d-%d-%dT%d:%d:%d+%d", &t->tm_year, &t->tm_mon,
           &t->tm_mday, &t->tm_hour, &t->tm_min, &t->tm_sec,
           &t->tm_isdst) != 7) {
        LOG_ERR("Failed to parse time of build!");
    }
    t->tm_year-=1900;
    t->tm_mon-=1;
    local_time = mktime(t);
}

void clock_init()
{
    /* Set time to time of build */
    clock_str_to_local_time(TIME_OF_BUILD, &ti);
    LOG_DBG("Time set to time of build");
    LOG_DBG("Clock init: Done");
}

struct tm *clock_get_time()
{
    return &ti;
}

void clock_sync_time(cts_datetime_t *cts)
{
    ti.tm_year = cts->year -1900;
    ti.tm_mon = cts->month -1;
    ti.tm_mday = cts->day;
    ti.tm_hour = cts->hours;
    ti.tm_min = cts->minutes;
    ti.tm_sec = cts->seconds;

    local_time = mktime(&ti);
}

char *clock_get_local_time()
{
    return ctime(&local_time);
}

/* Called by event handler */
void clock_increment_local_time()
{
    static uint64_t last_uptime_ms;
    uint64_t uptime_ms;
    uint64_t elapsed_time_ms;

    uptime_ms = k_uptime_get();
    elapsed_time_ms = uptime_ms - last_uptime_ms;
    last_uptime_ms = uptime_ms;
    local_time += elapsed_time_ms / 1000;
}

void clock_show_time()
{
    char wday[4];
    char mon[4];
    char time_label_str[32];
    char date_label_str[32];


    if (sscanf(clock_get_local_time(), "%s %s", wday, mon) != 2) {
        LOG_ERR("Failed to print time!");
    }
    LOG_INF("%s %d %s | %02d:%02d", log_strdup(wday),
        localtime(&local_time)->tm_mday,
        log_strdup(mon), localtime(&local_time)->tm_hour,
        localtime(&local_time)->tm_min);
    sprintf(time_label_str, "%02d:%02d", localtime(&local_time)->tm_hour,
        localtime(&local_time)->tm_min);
    sprintf(date_label_str, "%s %d %s", wday,
        localtime(&local_time)->tm_mday, mon);

    gfx_time_set_label(time_label_str);
    gfx_date_set_label(date_label_str);
}
```

## src/cts_sync.c
```c
/*
 * Modifications of najnesnaj's clock-cts sample:
 * Copyright (c) 2020 Endian Technologies AB
 *
 * Modifications of endian-albin's pinetime-hypnos:
 * Copyright (c) 2020 max00
 *
 * SPDX-License-Identifier: Apache-2.0
 */
#include <zephyr.h>
#include <zephyr/types.h>
#include <bluetooth/conn.h>
#include <bluetooth/uuid.h>
#include <bluetooth/gatt.h>
#include <time.h>
#include "log.h"
#include "cts_sync.h"
#include "bt.h"

//---- DEFINITIONS ----//
#define CTS_SYNC_INTERVAL   K_SECONDS(60)


//---- FUNCTION PROTOYPES ----//
static void cts_sync_timer_timeout_handler(struct k_timer *tmr);
static void cts_sync_processor(struct bt_conn *conn, void *data);


//---- VARIABLES ----//
static struct k_timer m_cts_sync_timer;
static struct bt_gatt_discover_params cts_discovery_params;
static struct bt_uuid_16 uuid = BT_UUID_INIT_16(0);
static struct bt_gatt_read_params read_params;
cts_datetime_t clock_datetime;
static struct {
    int offset;
    cts_datetime_t datetime;
} m_read_buf;


//---- FUNCTIONS ----//
void cts_sync_init()
{
    k_timer_init(&m_cts_sync_timer, cts_sync_timer_timeout_handler, NULL);
}

void cts_sync_enable(bool enable)
{
    if(enable) {
        k_timer_start(&m_cts_sync_timer, K_NO_WAIT, CTS_SYNC_INTERVAL);
    } else {
        k_timer_stop(&m_cts_sync_timer);
    }
}

void cts_get_datetime(struct tm *t)
{
    t->tm_year = clock_datetime.year -1900;
    t->tm_mon = clock_datetime.month -1;
    t->tm_mday = clock_datetime.day;
    t->tm_hour = clock_datetime.hours;
    t->tm_min = clock_datetime.minutes;
    t->tm_sec = clock_datetime.seconds;
}


static void cts_sync_timer_timeout_handler(struct k_timer *tmr)
{
    bt_conn_foreach(BT_CONN_TYPE_LE, cts_sync_processor, NULL);
}



static void sync_cts_to_clock(cts_datetime_t* cts_datetime)
{
    memcpy(&clock_datetime, cts_datetime, sizeof(clock_datetime));
    clock_sync_time(cts_datetime);
}


uint8_t cts_sync_read(struct bt_conn *conn, uint8_t err,
                    struct bt_gatt_read_params *params,
                    const void *data, uint16_t length)
{
    LOG_DBG("Reading CCC data: err %d, %d bytes, offset %d.", err, length, m_read_buf.offset);

    if (!data || length <= 0) {
        sync_cts_to_clock(&m_read_buf.datetime);
        return BT_GATT_ITER_STOP;
    }

    memcpy(&m_read_buf.datetime + m_read_buf.offset, data, length);
    m_read_buf.offset += length;

    return BT_GATT_ITER_CONTINUE;
}

uint8_t cts_sync_service_discovered(struct bt_conn* conn, const struct bt_gatt_attr* attr,
        struct bt_gatt_discover_params* params)
{
    if (!attr) {
        LOG_INF("CTS Service Discovery completed");
        return BT_GATT_ITER_STOP;
    }
    LOG_DBG("Discovered attribute, handle: %u", attr->handle);

    memset(&read_params, 0, sizeof(read_params));
    read_params.func = cts_sync_read;
    read_params.by_uuid.uuid = (struct bt_uuid *) &uuid;
    read_params.by_uuid.start_handle = attr->handle;
    read_params.by_uuid.end_handle = 0xffff;
    m_read_buf.offset = 0;
    if (bt_gatt_read(conn, &read_params) < 0) {
        LOG_DBG("Could not initiate read of CCC data.");
    }

    return BT_GATT_ITER_STOP;
}

void cts_sync_processor(struct bt_conn *conn, void *data)
{
    memcpy(&uuid, BT_UUID_CTS_CURRENT_TIME, sizeof(uuid));
    cts_discovery_params.func = cts_sync_service_discovered;
    cts_discovery_params.start_handle = 0x0001;
    cts_discovery_params.end_handle = 0xFFFF;
    cts_discovery_params.type = BT_GATT_DISCOVER_CHARACTERISTIC;
    cts_discovery_params.uuid = (struct bt_uuid *) &uuid;

    if (bt_gatt_discover(conn, &cts_discovery_params) != 0) {
        LOG_ERR("CTS Sync > GATT discovery FAILED.");
    }
}
```

## src/event_handler.c
```c
/*
 * Copyright (c) 2020 Endian Technologies AB
 * Copyright (c) 2020 max00
 *
 * SPDX-License-Identifier: MPL-2.0
 */

#include <zephyr.h>
#include <zephyr/types.h>
#include <drivers/gpio.h>
#include <drivers/sensor.h>
#include <stdbool.h>
#include "backlight.h"
#include "battery.h"
#include "bt.h"
#include "clock.h"
#include "display.h"
#include "event_handler.h"
#include "gfx.h"
#include "log.h"

/* ********** defines ********** */
#define BAT_CHA 12
//#define BTN_PORT DT_NODELABEL(button0)
//#define BTN_IN  DT_NODELABEL(button0)
#define BTN_IN_PIN 14
#define BTN_OUT_PIN 15
#define TOUCH_PORT  CONFIG_CST816S_NAME
#define DISPLAY_TIMEOUT K_SECONDS(5)
/* ********** ******* ********** */

/* ********** variables ********** */
static struct k_timer display_off_timer;
static struct device *charging_dev;
static struct gpio_callback charging_cb;
static struct device *button_dev;
static struct gpio_callback button_cb;
static struct device *touch_dev;
static struct sensor_trigger tap = {
	.type = SENSOR_TRIG_DATA_READY,
	.chan = SENSOR_CHAN_ACCEL_XYZ,
};
/* ********** ********* ********** */

/* ********** init function ********** */
void event_handler_init()
{
	/* Initialize GPIOs */
    charging_dev = device_get_binding("GPIO_0");
    gpio_pin_configure(charging_dev, BAT_CHA, GPIO_INPUT | GPIO_INT_EDGE_BOTH);
    gpio_init_callback(&charging_cb, battery_charging_isr, BIT(BAT_CHA));

	button_dev = device_get_binding("GPIO_0");
	gpio_pin_configure(button_dev, BTN_IN_PIN, GPIO_INPUT | GPIO_INT_EDGE_FALLING | GPIO_PULL_UP);
	gpio_init_callback(&button_cb, button_pressed_isr, BIT(BTN_IN_PIN));

	touch_dev = device_get_binding(TOUCH_PORT);

	/* Enable GPIOs */
	gpio_add_callback(charging_dev, &charging_cb);
	gpio_add_callback(button_dev, &button_cb);
	sensor_trigger_set(touch_dev, &tap, touch_tap_isr);

	/* Set button out pin to high to enable the button */
	uint32_t button_out = 1U;
        gpio_pin_configure(button_dev, BTN_OUT_PIN, GPIO_OUTPUT);
        gpio_pin_set_raw(button_dev, BTN_OUT_PIN, button_out);

	/* Initialize timers */
	k_timer_init(&display_off_timer, display_off_isr, NULL);

	/* Start timers */
	k_timer_start(&display_off_timer, DISPLAY_TIMEOUT, K_NO_WAIT);

	/* Special cases */
        /* Get battery charging status */
	k_sleep(K_MSEC(10));
        uint32_t res =  gpio_pin_get(charging_dev, BAT_CHA);
        battery_update_charging_status(res != 1U);

        /* Show time, date and battery status */
	clock_show_time();
	battery_show_status();

	LOG_DBG("Event handler init: Done");
}
/* ********** ************ ********** */

/* ********** interrupt handlers ********** */
void display_off_isr(struct k_timer *light_off)
{
	backlight_enable(false);
	display_sleep();
}

void battery_charging_isr(struct device *gpiobat, struct gpio_callback *cb, uint32_t pins)
{
	uint32_t res = gpio_pin_get(charging_dev, BAT_CHA);
	battery_update_charging_status(res != 1U);
}

void button_pressed_isr(struct device *gpiobtn, struct gpio_callback *cb, uint32_t pins)
{
	backlight_enable(true);
	k_timer_start(&display_off_timer, DISPLAY_TIMEOUT, K_NO_WAIT);
	display_wake_up();
	clock_show_time();
	battery_show_status();
	gfx_update();
}

void touch_tap_isr(struct device *touch_dev, struct sensor_trigger *tap)
{
	backlight_enable(true);
	k_timer_start(&display_off_timer, DISPLAY_TIMEOUT, K_NO_WAIT);
	display_wake_up();
	clock_increment_local_time();
	clock_show_time();
	battery_show_status();
	gfx_update();
}

/* ********** ************** ********** */
```

## src/gfx.c
```c
/*
 * Copyright (c) 2020 Endian Technologies AB
 *
 * SPDX-License-Identifier: MPL-2.0
 */

#include <lvgl.h>
#include "log.h"

/* ********** defines ********** */
//#define LV_IMG_DECLARE(var_name) extern const lv_img_dsc_t var_name;
//LV_IMG_DECLARE(evelyn);
#define BAT_LABEL_MARGIN 3
/* ********** ******* ********** */

/* ********** variables ********** */
static lv_obj_t *battery_label;
static lv_obj_t *bt_label;
static lv_obj_t *time_label;
static lv_obj_t *date_label;
/* ********** ********* ********** */

void gfx_init(void)
{
    /* Text color */
    static lv_style_t style;
    lv_style_copy(&style, &lv_style_plain);
    //lv_style_plain.text.color = LV_COLOR_WHITE;
    //lv_style_plain.body.main_color = LV_COLOR_BLACK;
    style.text.color = LV_COLOR_WHITE;
    style.body.main_color = LV_COLOR_BLACK;
    style.body.grad_color = LV_COLOR_BLACK;
    lv_obj_set_style(lv_scr_act(), &style);

    /* Background image Night and Sleep (public domain)
     * See https://en.wikipedia.org/wiki/Night_and_Sleep
     */
    //lv_obj_t *img_bin = lv_img_create(lv_scr_act(), NULL);
    //lv_img_set_src(img_bin, &evelyn);

    /* Battery label */
    battery_label = lv_label_create(lv_scr_act(), NULL);
    lv_label_set_style(battery_label, LV_LABEL_STYLE_MAIN, &lv_style_plain);
    lv_label_set_text(battery_label, "");

    /* Bluetooth label */
    bt_label = lv_label_create(lv_scr_act(), NULL);
    lv_obj_align(bt_label, NULL, LV_ALIGN_IN_TOP_LEFT, 0, 0);
    lv_label_set_text(bt_label, "");

    /* Time label */
    time_label = lv_label_create(lv_scr_act(), NULL);
    lv_label_set_style(time_label, LV_LABEL_STYLE_MAIN, &lv_style_plain);
    lv_label_set_text(time_label, "00:00");
    lv_obj_align(time_label, NULL, LV_ALIGN_CENTER, 0, -10);

    /* Date label */
    date_label = lv_label_create(lv_scr_act(), NULL);
    lv_label_set_style(date_label, LV_LABEL_STYLE_MAIN, &lv_style_plain);
    lv_label_set_text(date_label, "Mon 10 Jan");
    lv_obj_align(date_label, time_label, LV_ALIGN_CENTER, 0, 26);
    LOG_DBG("Graphics init: Done");

}

void gfx_update(void)
{
    lv_task_handler();
}


void gfx_time_set_label(char *str)
{
    lv_label_set_text(time_label, str);
}

void gfx_date_set_label(char *str)
{
    lv_label_set_text(date_label, str);
}

void gfx_bt_set_label(int symbol)
{
    if (symbol) {
        lv_label_set_text(bt_label, LV_SYMBOL_BLUETOOTH);
    } else {
        lv_label_set_text(bt_label, "");
    }
}

void gfx_battery_set_label(int symbol)
{
    switch (symbol) {
    case 5:
        lv_label_set_text(battery_label, LV_SYMBOL_CHARGE);
        lv_obj_align(battery_label, NULL, LV_ALIGN_IN_TOP_RIGHT, -BAT_LABEL_MARGIN, BAT_LABEL_MARGIN);
        break;
    case 4:
        lv_label_set_text(battery_label, LV_SYMBOL_BATTERY_FULL);
        break;
    case 3:
        lv_label_set_text(battery_label, LV_SYMBOL_BATTERY_3);
        break;
    case 2:
        lv_label_set_text(battery_label, LV_SYMBOL_BATTERY_2);
        break;
    case 1:
        lv_label_set_text(battery_label, LV_SYMBOL_BATTERY_1);
        break;
    default:
        lv_label_set_text(battery_label, LV_SYMBOL_BATTERY_EMPTY);
    }
    lv_obj_align(battery_label, NULL, LV_ALIGN_IN_TOP_RIGHT, -BAT_LABEL_MARGIN, 0);
}
```
